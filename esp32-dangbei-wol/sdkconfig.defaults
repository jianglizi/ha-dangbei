## esp32-dangbei-wol/sdkconfig.defaults
```kconfig
# ===== 目标芯片 =====
CONFIG_IDF_TARGET="esp32c3"

# ===== 分区表 =====
CONFIG_PARTITION_TABLE_CUSTOM=y
CONFIG_PARTITION_TABLE_CUSTOM_FILENAME="partitions.csv"

# ===== Flash =====
CONFIG_ESPTOOLPY_FLASHSIZE_4MB=y
CONFIG_ESPTOOLPY_FLASHSIZE="4MB"

# ===== WiFi =====
CONFIG_ESP_WIFI_SOFTAP_SUPPORT=y
CONFIG_LWIP_IPV6=y
CONFIG_LWIP_DHCPS=y

# ===== HTTP server =====
CONFIG_HTTPD_MAX_REQ_HDR_LEN=1024
CONFIG_HTTPD_MAX_URI_LEN=512

# ===== mDNS =====
CONFIG_MDNS_MAX_INTERFACES=2

# ===== Bluetooth: NimBLE host =====
CONFIG_BT_ENABLED=y
CONFIG_BT_NIMBLE_ENABLED=y
CONFIG_BT_NIMBLE_EXT_ADV=n
CONFIG_BT_NIMBLE_ROLE_PERIPHERAL=y
CONFIG_BT_NIMBLE_ROLE_BROADCASTER=y
CONFIG_BT_NIMBLE_ROLE_CENTRAL=n
CONFIG_BT_NIMBLE_ROLE_OBSERVER=n
CONFIG_BT_NIMBLE_NVS_PERSIST=n

# ===== 日志 =====
CONFIG_LOG_DEFAULT_LEVEL_INFO=y

# ===== FreeRTOS =====
CONFIG_FREERTOS_HZ=1000

# ===== Main task =====
CONFIG_ESP_MAIN_TASK_STACK_SIZE=4096
```
